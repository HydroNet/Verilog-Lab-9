	GLOBAL user_code
		IMPORT LCD_PINS
		IMPORT LCD_CMD
		IMPORT LCD_CHAR
		IMPORT DELAY
		IMPORT LCD_INIT
		IMPORT LCD_STRING
		IMPORT LCD_CLEAR
		AREA mycode, CODE, readonly
			
IO0PIN EQU 0XE0028000
	
user_code 
		BL LCD_PINS
		BL LCD_INIT
		
		LDR R0,=IO0PIN
		MOV R1, #0X40000000
		LDR R2,[R0]
		ORR R2,R2,R1
		STR R2,[R0]
		MOV R6, #0X80000000
		BL LCD_CMD
		MOV R6, #0X0F000000;CURSOR SET AT LOCATION 00 LINE 1
		LDR R8, =STRING1
		BL LCD_STRING
		
		MOV R6, #0XC0000000;CURSOR SET AT LOCATION 40 LINE 2
		LDR R8, =STRING2
		BL LCD_STRING
		
STOP B STOP

STRING1 DCB "TEST FIRST LINE",0
STRING2 DCB "TEST SECOND LINE",0
		ALIGN
		END